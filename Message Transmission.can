/*@!Encoding:1252*/
includes
{
  
}

variables
{
  message 0x100 msg1 = {dlc=3, byte(0)=0x10, byte(1)=0x20, byte(2)=0x30, byte(3)=0x40 };
  message 0x265 msg2 = {dlc=8, byte(0)=0xAA, byte(1)=0xBB, byte(2)=0xCC, byte(3)=0xDD, byte(4)=0xEE};
  message 0x217 msg3 = {dlc=4, byte(0)=0x10, byte(1)=0x20, byte(2)=0x30, byte(3)=0x40};
  message 0x266 msg4 = {dlc=6, byte(0)=0x15, byte(1)=0x25, byte(2)=0x35, byte(3)=0x45, byte(4)=0x55, byte(5)=0x65};
  message 0x269 msg5 = {dlc=3, byte(0)=0x5A, byte(1)=0x6B, byte(2)=0x7C};
  message 0x267 msg6 = {dlc=7, byte(0)=0x40, byte(1)=0x50, byte(2)=0x60, byte(3)=0x70, byte(4)=0x80, byte(5)=0x90, byte(6)=0xA0};
  message 0x270 msg7 = {dlc=5, byte(0)=0x11, byte(1)=0x22, byte(2)=0x33, byte(3)=0x44, byte(4)=0x55};
  message 0x271 msg8 = {dlc=8, byte(0)=0x77, byte(1)=0x88, byte(2)=0x99, byte(3)=0xAA, byte(4)=0xBB, byte(5)=0xCC, byte(6)=0xDD, byte(7)=0xEE};
  message 0x272 msg9 = {dlc=4, byte(0)=0x55, byte(1)=0x66, byte(2)=0x77, byte(3)=0x88};
  message 0x273 msg10 = {dlc=6, byte(0)=0x31, byte(1)=0x42, byte(2)=0x53, byte(3)=0x64, byte(4)=0x75, byte(5)=0x86};
  message 0x274 msg11 = {dlc=3, byte(0)=0x80, byte(1)=0x90, byte(2)=0xA0};
  message 0x275 msg12 = {dlc=7, byte(0)=0x14, byte(1)=0x24, byte(2)=0x34, byte(3)=0x44, byte(4)=0x54, byte(5)=0x64, byte(6)=0x74};
  message 0x276 msg13 = {dlc=5, byte(0)=0x20, byte(1)=0x30, byte(2)=0x40, byte(3)=0x50, byte(4)=0x60};
  message 0x277 msg14 = {dlc=8, byte(0)=0xB1, byte(1)=0xC2, byte(2)=0xD3, byte(3)=0xE4, byte(4)=0xF5, byte(5)=0xA6, byte(6)=0xB7, byte(7)=0xC8};
  message 0x278 msg15 = {dlc=4, byte(0)=0x10, byte(1)=0x21, byte(2)=0x32, byte(3)=0x43};
  message 0x279 msg16 = {dlc=6, byte(0)=0x73, byte(1)=0x84, byte(2)=0x95, byte(3)=0xA6, byte(4)=0xB7, byte(5)=0xC8};
}

on start
{
  output(msg1);
  output(msg2);
  output(msg3);
  output(msg4);
  output(msg5);
  output(msg6);
  output(msg7);
  output(msg8);
  output(msg9);
  output(msg10);
  output(msg11);
  output(msg12);
  output(msg13);
  output(msg14);
  output(msg15);
  output(msg16);
  write("Simulation Starts");
}
