/*@!Encoding:1252*/
includes
{
  
}

variables
{
  message 0x100 msg = {dlc=3, byte(0)=0x10, byte(1)=0x20, byte(2)=0x30, byte(3)=0x40 };
  message 0x200 cyclic;
  msTimer t1;
}

//msTimer - used to specify precise timing.

on start
{
  output(msg);
  write("Simulation Started");
  setTimer (t1,4000);
}

//SetTimer - This sets a timer to trigger an event after a specified time. It is useful to control an event. 
//In this example, it means cyclic message starts 4s after the script starts and transmits one message every 1s.            

on timer t1
{
  cyclic.dlc=3;
  cyclic.byte(0)=0x11;
  cyclic.byte(1)=0x22;
  cyclic.byte(2)=0x33;
  output(cyclic);
  setTimer(t1,1000);
}
  


// On Start Event - When the script runs, these commands are executed
/*on start 
{
  output(msg);
  write("Simulation Started");
}*/



// On Key Event - On pressing a particular key (in this case 'm', message is transmitted.
/*on key 'm'
{
output(msg);
}*/

